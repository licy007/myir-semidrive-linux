/*
 * Semidrive kunlun platform DTS file
 *
 * Copyright (C) 2019, Semidrive  Communications Inc.
 *
 * This file is licensed under a dual GPLv2 or X11 license.
 */

/dts-v1/;
#include "x9_high_ref_native_ivi.dts"
&uart9 {
	status = "disabled";
};

