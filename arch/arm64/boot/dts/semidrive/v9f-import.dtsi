/*
* Semidrive G9 platform DTS file
*
* Copyright (C) 2019, Semidrive  Communications Inc.
*
* This file is licensed under a dual GPLv2 or X11 license.
*/

/ {
	soc{

		rtc: rtc@0x31810000 {
			compatible = "semidrive,sdrv-rtc";
			reg = <0x0 0x31810000 0x0 0x10000>;
			interrupts = <0 220 IRQ_TYPE_LEVEL_HIGH>;
			status = "disabled";
		};

	};
};
