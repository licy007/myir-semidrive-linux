/*
 * Semidrive D9 platform DTS file
 *
 * Copyright (C) 2019, Semidrive Communications Inc.
 *
 * This file is licensed under a dual GPLv2 or X11 license.
 */

#include <dt-bindings/reset/sdriv-rstgen.h>

&rstgen {
	rstgen_module_base = <0x0 0x38440000>;
	rstgen_core_base = <0x0 0x38401000>;
	reg = <0x0 0x38440000 0x0 0x1000>,	/* ospi2 */
		<0x0 0x38441000 0x0 0x1000>,	/* i2s_sc3 */
		<0x0 0x38442000 0x0 0x1000>,	/* i2s_sc4 */
		<0x0 0x38443000 0x0 0x1000>,	/* i2s_sc5 */
		<0x0 0x38444000 0x0 0x1000>,	/* i2s_sc6 */
		<0x0 0x38445000 0x0 0x1000>,	/* i2s_sc7 */
		<0x0 0x38446000 0x0 0x1000>,	/* i2s_sc8 */
		<0x0 0x38447000 0x0 0x1000>,	/* i2s_mc1 */
		<0x0 0x38448000 0x0 0x1000>,	/* i2s_mc2 */
		<0x0 0x3844d000 0x0 0x1000>,	/* eth2 */
		<0x0 0x3844e000 0x0 0x1000>,	/* mshc1 */
		<0x0 0x3844f000 0x0 0x1000>,	/* mshc2 */
		<0x0 0x38450000 0x0 0x1000>,	/* msch3 */
		<0x0 0x38451000 0x0 0x1000>,	/* msch4 */
		<0x0 0x38455000 0x0 0x1000>,	/* cpu1 core0 warm */
		<0x0 0x38456000 0x0 0x1000>,	/* cpu1 core1 warm */
		<0x0 0x38457000 0x0 0x1000>,	/* cpu1 core2 warm */
		<0x0 0x38458000 0x0 0x1000>,	/* cpu1 core3 warm */
		<0x0 0x38459000 0x0 0x1000>,	/* cpu1 core4 warm */
		<0x0 0x3845a000 0x0 0x1000>,	/* cpu1 core5 warm */
		<0x0 0x3845b000 0x0 0x1000>,	/* cpu1 scu warm */
		<0x0 0x38461000 0x0 0x1000>,	/* GIC 4 */
		<0x0 0x38462000 0x0 0x1000>,	/* GIC 5 */
		<0x0 0x38464000 0x0 0x1000>,	/* cssys treset n */
		<0x0 0x38466000 0x0 0x1000>,	/* vdsp.DReset */
		<0x0 0x38467000 0x0 0x1000>,	/* vpu1 */
		<0x0 0x38468000 0x0 0x1000>,	/* vpu2 */
		<0x0 0x3846d000 0x0 0x1000>,	/* cpu1 ss */
		<0x0 0x3846e000 0x0 0x1000>,	/* cpu2 ss */
		<0x0 0x38478000 0x0 0x1000>,	/* mipi csi1 */
		<0x0 0x38479000 0x0 0x1000>,	/* mipi csi2 */
		<0x0 0x3847a000 0x0 0x1000>,	/* mipi csi3 */
		<0x0 0x3847b000 0x0 0x1000>,	/* mipi dsi1 */
		<0x0 0x3847c000 0x0 0x1000>,	/* mipi dsi2 */
		<0x0 0x3847d000 0x0 0x1000>,	/* dc1 */
		<0x0 0x38485000 0x0 0x1000>,	/* lvds ss */
		<0x0 0x38486000 0x0 0x1000>,	/* csi1 */
		<0x0 0x38488000 0x0 0x1000>,	/* csi3 */
		<0x0 0x38489000 0x0 0x1000>,	/* disp mux */
		<0x0 0x3848a000 0x0 0x1000>,	/* g2d1 */
		<0x0 0x38490000 0x0 0x1000>,	/* gpu1 core */
		<0x0 0x38491000 0x0 0x1000>,	/* gpu1 ss */
		<0x0 0x38492000 0x0 0x1000>,	/* gpu2 core */
		<0x0 0x38493000 0x0 0x1000>,	/* gpu2 ss */
		<0x0 0x38499000 0x0 0x1000>,	/* dbg reg */
		<0x0 0x38401000 0x0 0x2000>,	/* vdsp core */
		<0x0 0x38407000 0x0 0x2000>,	/* cpu1 all core */
		<0x0 0x38409000 0x0 0x2000>;	/* cpu2 core */
	rstgen_resource = <RSTGEN_MODULE_OSPI2
			RSTGEN_MODULE_I2S_SC3
			RSTGEN_MODULE_I2S_SC4
			RSTGEN_MODULE_I2S_SC5
			RSTGEN_MODULE_I2S_SC6
			RSTGEN_MODULE_I2S_SC7
			RSTGEN_MODULE_I2S_SC8
			RSTGEN_MODULE_I2S_MC1
			RSTGEN_MODULE_I2S_MC2
			RSTGEN_MODULE_ETH2
			RSTGEN_MODULE_MSHC1
			RSTGEN_MODULE_MSHC2
			RSTGEN_MODULE_MSHC3
			RSTGEN_MODULE_MSHC4
			RSTGEN_MODULE_CPU1_CORE0_WARM
			RSTGEN_MODULE_CPU1_CORE1_WARM
			RSTGEN_MODULE_CPU1_CORE2_WARM
			RSTGEN_MODULE_CPU1_CORE3_WARM
			RSTGEN_MODULE_CPU1_CORE4_WARM
			RSTGEN_MODULE_CPU1_CORE5_WARM
			RSTGEN_MODULE_CPU1_SCU_WARM
			RSTGEN_MODULE_GIC4
			RSTGEN_MODULE_GIC5
			RSTGEN_MODULE_CSSYS_TRESET_N
			RSTGEN_MODULE_VDSP_DRESET
			RSTGEN_MODULE_VPU1
			RSTGEN_MODULE_VPU2
			RSTGEN_MODULE_CPU1_SS
			RSTGEN_MODULE_CPU2_SS
			RSTGEN_MODULE_MIPI_CSI1
			RSTGEN_MODULE_MIPI_CSI2
			RSTGEN_MODULE_MIPI_CSI3
			RSTGEN_MODULE_MIPI_DSI1
			RSTGEN_MODULE_MIPI_DSI2
			RSTGEN_MODULE_DC1
			RSTGEN_MODULE_LVDS_SS
			RSTGEN_MODULE_CSI1
			RSTGEN_MODULE_CSI3
			RSTGEN_MODULE_DISP_MUX
			RSTGEN_MODULE_G2D1
			RSTGEN_MODULE_GPU1_CORE
			RSTGEN_MODULE_GPU1_SS
			RSTGEN_MODULE_GPU2_CORE
			RSTGEN_MODULE_GPU2_SS
			RSTGEN_MODULE_DBG_REG
			RSTGEN_CORE_VDSP
			RSTGEN_CORE_CPU1_ALL
			RSTGEN_CORE_CPU2>;
	status = "okay";
};
