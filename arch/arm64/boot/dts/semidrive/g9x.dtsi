/*
* Semidrive G9 platform DTS file
*
* Copyright (C) 2019, Semidrive  Communications Inc.
*
* This file is licensed under a dual GPLv2 or X11 license.
*/

#include "g9.dtsi"
#include "g9-reset-base.dtsi"
