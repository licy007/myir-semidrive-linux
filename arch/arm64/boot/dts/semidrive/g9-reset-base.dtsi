/*
 * Semidrive G9 platform DTS file
 *
 * Copyright (C) 2019, Semidrive Communications Inc.
 *
 * This file is licensed under a dual GPLv2 or X11 license.
 */

#include <dt-bindings/reset/sdriv-rstgen.h>

&rstgen {
	rstgen_module_base = <0x0 0x38440000>;
	rstgen_core_base = <0x0 0x38401000>;
	reg = <0x0 0x38440000 0x0 0x1000>,	/* ospi2 */
		<0x0 0x38441000 0x0 0x1000>,	/* i2s_sc3 */
		<0x0 0x38442000 0x0 0x1000>,	/* i2s_sc4 */
		<0x0 0x38445000 0x0 0x1000>,	/* i2s_sc7 */
		<0x0 0x38449000 0x0 0x1000>,	/* canfd5 */
		<0x0 0x3844a000 0x0 0x1000>,	/* canfd6 */
		<0x0 0x3844b000 0x0 0x1000>,	/* canfd7 */
		<0x0 0x3844c000 0x0 0x1000>,	/* canfd8 */
		<0x0 0x3844d000 0x0 0x1000>,	/* eth2 */
		<0x0 0x3844e000 0x0 0x1000>,	/* mshc1 */
		<0x0 0x3844f000 0x0 0x1000>,	/* mshc2 */
		<0x0 0x38450000 0x0 0x1000>,	/* msch3 */
		<0x0 0x38462000 0x0 0x1000>,	/* GIC 5 */
		<0x0 0x38464000 0x0 0x1000>,	/* cssys treset n */
		<0x0 0x3846e000 0x0 0x1000>,	/* cpu2 ss */
		<0x0 0x38499000 0x0 0x1000>,	/* dbg reg */
		<0x0 0x3849a000 0x0 0x1000>,	/* canfd9 */
		<0x0 0x3849b000 0x0 0x1000>,	/* canfd10 */
		<0x0 0x3849c000 0x0 0x1000>,	/* canfd11 */
		<0x0 0x3849d000 0x0 0x1000>,	/* canfd12 */
		<0x0 0x3849e000 0x0 0x1000>,	/* canfd13 */
		<0x0 0x3849f000 0x0 0x1000>,	/* canfd14 */
		<0x0 0x384a0000 0x0 0x1000>,	/* canfd15 */
		<0x0 0x384a1000 0x0 0x1000>,	/* canfd16 */
		<0x0 0x384a2000 0x0 0x1000>,	/* canfd17 */
		<0x0 0x384a3000 0x0 0x1000>,	/* canfd18 */
		<0x0 0x384a4000 0x0 0x1000>,	/* canfd19 */
		<0x0 0x384a5000 0x0 0x1000>,	/* canfd20 */
		<0x0 0x38409000 0x0 0x2000>;	/* cpu2 core */
	rstgen_resource = <RSTGEN_MODULE_OSPI2
			RSTGEN_MODULE_I2S_SC3
			RSTGEN_MODULE_I2S_SC4
			RSTGEN_MODULE_I2S_SC7
			RSTGEN_MODULE_CANFD5
			RSTGEN_MODULE_CANFD6
			RSTGEN_MODULE_CANFD7
			RSTGEN_MODULE_CANFD8
			RSTGEN_MODULE_ETH2
			RSTGEN_MODULE_MSHC1
			RSTGEN_MODULE_MSHC2
			RSTGEN_MODULE_MSHC3
			RSTGEN_MODULE_GIC5
			RSTGEN_MODULE_CSSYS_TRESET_N
			RSTGEN_MODULE_CPU2_SS
			RSTGEN_MODULE_DBG_REG
			RSTGEN_MODULE_CANFD9
			RSTGEN_MODULE_CANFD10
			RSTGEN_MODULE_CANFD11
			RSTGEN_MODULE_CANFD12
			RSTGEN_MODULE_CANFD13
			RSTGEN_MODULE_CANFD14
			RSTGEN_MODULE_CANFD15
			RSTGEN_MODULE_CANFD16
			RSTGEN_MODULE_CANFD17
			RSTGEN_MODULE_CANFD18
			RSTGEN_MODULE_CANFD19
			RSTGEN_MODULE_CANFD20
			RSTGEN_CORE_CPU2
		>;
	status = "okay";
};
