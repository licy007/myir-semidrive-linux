/*
 * Semidrive V9 platform DTS file
 *
 * Copyright (C) 2019, Semidrive Communications Inc.
 *
 * This file is licensed under a dual GPLv2 or X11 license.
 */

#include <dt-bindings/reset/sdriv-rstgen.h>

&rstgen {
	rstgen_module_base = <0x0 0x38440000>;
	rstgen_core_base = <0x0 0x38401000>;
	reg = <0x0 0x38440000 0x0 0x1000>,	/* ospi2 */
		<0x0 0x38441000 0x0 0x1000>,	/* i2s_sc3 */
		<0x0 0x38442000 0x0 0x1000>,	/* i2s_sc4 */
		<0x0 0x38449000 0x0 0x1000>,	/* canfd5 */
		<0x0 0x3844a000 0x0 0x1000>,	/* canfd6 */
		<0x0 0x3844b000 0x0 0x1000>,	/* canfd7 */
		<0x0 0x3844c000 0x0 0x1000>,	/* canfd8 */
		<0x0 0x3844d000 0x0 0x1000>,	/* eth2 */
		<0x0 0x3844e000 0x0 0x1000>,	/* mshc1 */
		<0x0 0x3844f000 0x0 0x1000>,	/* mshc2 */
		<0x0 0x38450000 0x0 0x1000>,	/* msch3 */
		<0x0 0x38455000 0x0 0x1000>,	/* cpu1 core0 warm */
		<0x0 0x38456000 0x0 0x1000>,	/* cpu1 core1 warm */
		<0x0 0x38457000 0x0 0x1000>,	/* cpu1 core2 warm */
		<0x0 0x38458000 0x0 0x1000>,	/* cpu1 core3 warm */
		<0x0 0x3845b000 0x0 0x1000>,	/* cpu1 scu warm */
		<0x0 0x38461000 0x0 0x1000>,	/* GIC 4 */
		<0x0 0x38462000 0x0 0x1000>,	/* GIC 5 */
		<0x0 0x38464000 0x0 0x1000>,	/* cssys treset n */
		<0x0 0x38466000 0x0 0x1000>,	/* vdsp.DReset */
		<0x0 0x38468000 0x0 0x1000>,	/* vpu2 */
		<0x0 0x38469000 0x0 0x1000>,	/* mjpeg */
		<0x0 0x3846d000 0x0 0x1000>,	/* cpu1 ss */
		<0x0 0x3846e000 0x0 0x1000>,	/* cpu2 ss */
		<0x0 0x38478000 0x0 0x1000>,	/* mipi csi1 */
		<0x0 0x38479000 0x0 0x1000>,	/* mipi csi2 */
		<0x0 0x3847a000 0x0 0x1000>,	/* mipi csi3 */
		<0x0 0x3847b000 0x0 0x1000>,	/* mipi dsi1 */
		<0x0 0x3847d000 0x0 0x1000>,	/* dc1 */
		<0x0 0x38486000 0x0 0x1000>,	/* csi1 */
		<0x0 0x38487000 0x0 0x1000>,	/* csi2 */
		<0x0 0x38488000 0x0 0x1000>,	/* csi3 */
		<0x0 0x38489000 0x0 0x1000>,	/* disp mux */
		<0x0 0x3848b000 0x0 0x1000>,	/* g2d2 */
		<0x0 0x38490000 0x0 0x1000>,	/* gpu1 core */
		<0x0 0x38491000 0x0 0x1000>,	/* gpu1 ss */
		<0x0 0x38492000 0x0 0x1000>,	/* gpu2 core */
		<0x0 0x38493000 0x0 0x1000>,	/* gpu2 ss */
		<0x0 0x38499000 0x0 0x1000>,	/* dbg reg */
		<0x0 0x3849a000 0x0 0x1000>,	/* canfd9 */
		<0x0 0x3849b000 0x0 0x1000>,	/* canfd10 */
		<0x0 0x3849c000 0x0 0x1000>,	/* canfd11 */
		<0x0 0x3849d000 0x0 0x1000>,	/* canfd12 */
		<0x0 0x3849e000 0x0 0x1000>,	/* canfd13 */
		<0x0 0x3849f000 0x0 0x1000>,	/* canfd14 */
		<0x0 0x384a0000 0x0 0x1000>,	/* canfd15 */
		<0x0 0x384a1000 0x0 0x1000>,	/* canfd16 */
		<0x0 0x384a2000 0x0 0x1000>,	/* canfd17 */
		<0x0 0x384a3000 0x0 0x1000>,	/* canfd18 */
		<0x0 0x384a4000 0x0 0x1000>,	/* canfd19 */
		<0x0 0x384a5000 0x0 0x1000>,	/* canfd20 */
		<0x0 0x38401000 0x0 0x2000>,	/* vdsp core */
		<0x0 0x38407000 0x0 0x2000>,	/* cpu1 all core */
		<0x0 0x38409000 0x0 0x2000>;	/* cpu2 core */
	rstgen_resource = <RSTGEN_MODULE_OSPI2
			RSTGEN_MODULE_I2S_SC3
			RSTGEN_MODULE_I2S_SC4
			RSTGEN_MODULE_CANFD5
			RSTGEN_MODULE_CANFD6
			RSTGEN_MODULE_CANFD7
			RSTGEN_MODULE_CANFD8
			RSTGEN_MODULE_ETH2
			RSTGEN_MODULE_MSHC1
			RSTGEN_MODULE_MSHC2
			RSTGEN_MODULE_MSHC3
			RSTGEN_MODULE_CPU1_CORE0_WARM
			RSTGEN_MODULE_CPU1_CORE1_WARM
			RSTGEN_MODULE_CPU1_CORE2_WARM
			RSTGEN_MODULE_CPU1_CORE3_WARM
			RSTGEN_MODULE_CPU1_SCU_WARM
			RSTGEN_MODULE_GIC4
			RSTGEN_MODULE_GIC5
			RSTGEN_MODULE_CSSYS_TRESET_N
			RSTGEN_MODULE_VDSP_DRESET
			RSTGEN_MODULE_VPU2
			RSTGEN_MODULE_MJPEG
			RSTGEN_MODULE_CPU1_SS
			RSTGEN_MODULE_CPU2_SS
			RSTGEN_MODULE_MIPI_CSI1
			RSTGEN_MODULE_MIPI_CSI2
			RSTGEN_MODULE_MIPI_CSI3
			RSTGEN_MODULE_MIPI_DSI1
			RSTGEN_MODULE_DC1
			RSTGEN_MODULE_CSI1
			RSTGEN_MODULE_CSI2
			RSTGEN_MODULE_CSI3
			RSTGEN_MODULE_DISP_MUX
			RSTGEN_MODULE_G2D2
			RSTGEN_MODULE_GPU1_CORE
			RSTGEN_MODULE_GPU1_SS
			RSTGEN_MODULE_GPU2_CORE
			RSTGEN_MODULE_GPU2_SS
			RSTGEN_MODULE_DBG_REG
			RSTGEN_MODULE_CANFD9
			RSTGEN_MODULE_CANFD10
			RSTGEN_MODULE_CANFD11
			RSTGEN_MODULE_CANFD12
			RSTGEN_MODULE_CANFD13
			RSTGEN_MODULE_CANFD14
			RSTGEN_MODULE_CANFD15
			RSTGEN_MODULE_CANFD16
			RSTGEN_MODULE_CANFD17
			RSTGEN_MODULE_CANFD18
			RSTGEN_MODULE_CANFD19
			RSTGEN_MODULE_CANFD20
			RSTGEN_CORE_VDSP
			RSTGEN_CORE_CPU1_ALL
			RSTGEN_CORE_CPU2
		>;
	status = "okay";
};
