/*
* Semidrive X9 platform DTS file
*
* Copyright (C) 2019, Semidrive  Communications Inc.
*
* This file is licensed under a dual GPLv2 or X11 license.
*/

#include "x9_high.dtsi"

/{
        interrupt-parent=<&gic4>;
        soc {
            /delete-node/ gpio@30400000;/*gpio2*/
            /delete-node/ gpio@30410000;/*gpio3*/
            /delete-node/ gpio@30430000;/*gpio5*/
            /delete-node/ timer@0x30900000;/*HW timer8 */
            /*/delete-node/ xrp@0; vdsp should remove later*/
            /*/delete-node/ csi@30cc0000; csi0 should remove later*/
            /*/delete-node/ csi-mipi@30d00000; csimipi0 should remove later*/
        };
};
