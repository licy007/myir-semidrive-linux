/dts-v1/;
/plugin/;

#include <dt-bindings/soc/sdrv_dt_mapping.h>

/{
	compatible = "semidrive,kunlun";
	chip-id = < SDRV_CHIPID_ALL >;
	board-type = < SDRV_BOARD_TYPE_MS >;
	board-id = < SDRV_BOARDID_ALL >;

	fragment@0 {
		target = <&sdhci3>;
		__overlay__ {
			non-removable;
		};
	};
};
