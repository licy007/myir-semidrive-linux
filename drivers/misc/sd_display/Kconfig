## drivers/misc/sd_display/Kconfig
```kconfig
menuconfig SD_DISPLAY_MISC
	tristate "Semidrive display bridge/serdes IC driver"
	depends on OF
	default y
	help
	  This is misc driver for display.


config SERDES_DS90UB9XX
	tristate "TI serdes ds90ub9xx driver"
	depends on SD_DISPLAY_MISC && I2C
	default y

config BRIDGE_LT9611
	tristate "bridge lt9611 driver"
	depends on SD_DISPLAY_MISC && I2C
	default n
```

## drivers/misc/xtensa-xvp/Kconfig
```kconfig
#
# Xtensa Remote Processing kernel driver
#
config VDSP
	bool "xtensa vision dsp support"
	default n
	help
	  Choose this if you have a xetensa vision dsp like p6 and want to use
	  the dsp for opencl or nn.

config XRP
	tristate "XRP driver"
	depends on VDSP
	default n
	help
	  This is the core of Cadence Xtensa Remote Processing driver.
	  It should be enabled to support applications communicating with
	  Xtensa DSPs through the XRP API.

	  If unsure, say N.

	  To compile this driver as a module, choose M here: the
	  module will be called xrp.

config XRP_DEBUG
	bool "Debug XRP"
	depends on XRP
	default n
	help
	  This enables verbose debug output of the XRP driver.

	  If unsure, say N.

config XRP_HW_SIMPLE
	tristate "XRP for simple hardware"
	depends on XRP
	default n
	help
	  This is hardware-specific XRP kernel driver for the simple
	  hardware. It should be enabled to support XRP on simple hardware
	  platforms.

	  If unsure, say N.

	  To compile this driver as a module, choose M here: the
	  module will be called xrp_hw_simple.

config XRP_HW_SEMIDRIVE
	tristate "XRP for Semidrive x9"
	depends on XRP
	default n
	help
	  This is hardware-specific XRP kernel driver for the Semidrive x9
	  hardware. It should be enabled to support XRP on Semidrive hardware
	  platforms.

	  If unsure, say N.

	  To compile this driver as a module, choose M here: the
	  module will be called xrp_hw_semidrive.

config XRP_HW_HIKEY960
	tristate "XRP for HiKey960"
	depends on XRP
	default n
	help
	  This is hardware-specific XRP kernel driver for the HiKey960
	  hardware. It should be enabled to support XRP on HiKey960
	  platform.

	  If unsure, say N.

	  To compile this driver as a module, choose M here: the
	  module will be called xrp_hw_hikey960.
```

## drivers/net/dsa/microchip/Kconfig
```kconfig
menuconfig MICROCHIP_KSZ
	tristate "Microchip KSZ series switch support"
	depends on NET_DSA
	select NET_DSA_TAG_KSZ
	help
	  This driver adds support for Microchip KSZ switch chips.

config MICROCHIP_KSZ_SPI_DRIVER
	tristate "KSZ series SPI connected switch driver"
	depends on MICROCHIP_KSZ && SPI
	help
	  Select to enable support for registering switches configured through SPI.

config NET_DSA_MICROCHIP_9896C_I2C
	tristate "external support eth switch ksz9896c"
	default n
	depends on I2C
	help
	  This is semidrive external external switch driver.
```

## drivers/net/ethernet/mv5072/Kconfig
```kconfig
config MV5072_ENET
        tristate "Marvell 5072 PCIe ethernet driver"
        help
	  Say Y or M here if you want to use the Marvell 5072 PCIe ethernet driver.
```

## drivers/net/ethernet/netswift/Kconfig
```kconfig
#
# Netswift Ethernet device configuration
#
config NET_VENDOR_NETSWIFT
	bool "Netswift devices"
	default y
	---help---
	  If you have a network (Ethernet) device belonging to this class, say Y.

	  Note that the answer to this question doesn't directly affect the
	  kernel: saying N will just cause the configurator to skip all
	  the questions about Netswift devices. If you say Y, you will be asked
	  for your specific device in the following questions.

if NET_VENDOR_NETSWIFT

config NGBE
	tristate "Netswift PCI Ethernet Device support"
	depends on PCI
	---help---
	  This option enables driver support for WX1860AL4:

	  If you have a network (Ethernet) card of this type, say Y here.

	  To compile this driver as a module, choose M here.
endif
```

## drivers/phy/semidrive/Kconfig
```kconfig
#
# Phy drivers for Semidrive devices
#
config PHY_SEMIDRIVE_USB
    tristate "Semidrive USB PHY Driver"
    depends on ARCH_SEMIDRIVE && OF
    select GENERIC_PHY
    help
      Say 'Y' here to add support for Semidrive USB PHY driver,
      it supports usb2.0, usb3.0.
```

## drivers/pinctrl/semidrive/Kconfig
```kconfig
config PINCTRL_SEMIDRIVE
	bool
	depends on OF
	depends on ARCH_SEMIDRIVE
	select GENERIC_PINCTRL_GROUPS
	select GENERIC_PINMUX_FUNCTIONS
	select GENERIC_PINCONF
	select REGMAP

config PINCTRL_SD_MEMMAP
	bool

config PINCTRL_SDX9
	bool "Semidrive kunlun pinctrl driver"
	select PINCTRL_SEMIDRIVE
	select PINCTRL_SD_MEMMAP
	help
	  Say Y here to enable the semidrive x9 pinctrl driver
```

## drivers/soc/semidrive/Kconfig
```kconfig
#
# Semidrive SoC drivers
#
menu "Semidrive SoC drivers"

config SEMIDRIVE_IPCC
	tristate "Semidrive Inter-Processor Communication Channel"
	depends on ARCH_SEMIDRIVE
	depends on MAILBOX
	depends on RPMSG_SEMIDRIVE
	help
	  This enables support for the shared memory regions for inter-processor communication

config SEMIDRIVE_SCR
	tristate "Semidrive SCR driver"
	depends on ARCH_SEMIDRIVE
	select HWSEM_SEMIDRIVE
	default n
	help
	  SemiDrive System Control Register driver.

config SEMIDRIVE_VCE
	tristate "Semidrive VCE driver"
	depends on ARCH_SEMIDRIVE
	default n
	help
	  SemiDrive virtual crypto eng driver.

config SEMIDRIVE_PFM
	tristate "Semidrive ddr pfm driver"
	depends on ARCH_SEMIDRIVE
	default n
	help
	  SemiDrive ddr performance monitor driver.

config SEMIDRIVE_SDPE_RPC
	tristate "Semidrive SDPE Communication Channel"
	depends on ARCH_SEMIDRIVE
	depends on MAILBOX
	depends on RPMSG_SEMIDRIVE
	help
	  This enables support for the shared memory regions for sdpe communication

config SEMIDRIVE_ULINK
	tristate "Semidrive ulink module"
	depends on ARCH_SEMIDRIVE
	depends on MAILBOX
	default n
	help
	  This enables support for Semidrive ulink module between side A/B

config SEMIDRIVE_REGCTL
	tristate "Semidrive generic register programming driver"
	depends on ARCH_SEMIDRIVE
	default n
	help
	  This adds support for Semidriver SOC generic register programming.

config SEMIDRIVE_TIME_SYNC
        tristate "Semidrive time sync module"
        depends on ARCH_SEMIDRIVE
        depends on MAILBOX
        depends on PTP_1588_CLOCK_SD
        default n
        help
          This enables support for Semidrive time(RTC and gPTP) sync

source "drivers/soc/semidrive/logbuf/Kconfig"
source "drivers/soc/semidrive/ramdump/Kconfig"

endmenu
```

## drivers/soc/semidrive/logbuf/Kconfig
```kconfig
config SEMIDRIVE_LOGBUF
	bool "Semidrive log buffer driver"
	help
	  we use the driver to access the log buffer which saved in the DDR.

if SEMIDRIVE_LOGBUF
config SEMIDRIVE_LOGBUF_SERVER_DEV
	tristate "Semidrive log buffer server device driver"
	help
	  we use the driver to detect changes of the log data.

config SEMIDRIVE_LOGBUF_CLIENT_DEV
	tristate "Semidrive log buffer client device driver"
	help
	  we use the driver to report lastlog to application tool.

endif
```

## drivers/soc/semidrive/ramdump/Kconfig
```kconfig
config SEMIDRIVE_CRASHDUMP_ELF
	bool "Semidrive crashdump elf"
	depends on ARCH_SEMIDRIVE
	depends on KEXEC_CORE
	help
	  we use the driver to generate kernel elf header.
```

## drivers/thermal/semidrive/Kconfig
```kconfig
menuconfig SEMIDRIVE_THERMAL
	bool "Semidrive thermel driver support"
	depends on ARCH_SEMIDRIVE
	help
	  Say Y if you want to enable semidrive sensor and cooling device driver.

if SEMIDRIVE_THERMAL

menu "semidrive thermal cooling device drivers"
source "drivers/thermal/semidrive/semidrive_cooling/Kconfig"
endmenu

menu "semidrive thermal pvt sensor drivers"
source "drivers/thermal/semidrive/semidrive_sensor/Kconfig"
endmenu

endif
```

## drivers/thermal/semidrive/semidrive_cooling/Kconfig
```kconfig
#
# semidrive cooling device drivers configuration
#
config SEMIDRIVE_CPUFREQ_COOLING
	tristate "semidrive cpufreq cooling"
	depends on CPU_FREQ
	depends on CPU_THERMAL
	help
	Say Y if you want to enable the cpufreq cooling device. and these cooling
	device can be bound to thermal zone trip points. When a trip point reached,
	the bound cooling device turns active to cool down the SoC.

config SEMIDRIVE_CPUCORE_COOLING
	tristate "semidrive cpucore cooling"
	depends on HOTPLUG_CPU
	depends on CPU_THERMAL
	help
	Say Y if you want to enable the cpucore cooling device. and these cooling
	device can be bound to thermal zone trip points. When a trip point reached,
	the bound cooling device turns active to cool down the SoC.
```

## drivers/thermal/semidrive/semidrive_sensor/Kconfig
```kconfig
config SEMIDRIVE_PVT_SENSOR
	tristate "Thermal sensor driver for SEMIDRIVE platform"
	depends on REGMAP_MMIO
	help
	Temperature pvt sensor on semidrive soc platform. The pvt thermal sensor driver used to
	get temp.
```

## net/rpmsg/Kconfig
```kconfig
#
# Rpmsg proto socket
#

config RPMSG_PROTO
	tristate "Rpmsg Socket protocol"
	select RPMSG
	help
	  API socket for rpmsg communications
```
