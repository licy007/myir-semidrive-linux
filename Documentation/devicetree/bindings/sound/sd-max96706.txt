## drivers/media/platform/sdrv-cam-v2/external/sensor/Kconfig
```kconfig
config VIDEO_SEMIDRIVE_OV5640
	tristate "Ov5640 for Semidrive"
	depends on VIDEO_SEMIDRIVE_V2

config VIDEO_SEMIDRIVE_AR0132_AP0101
	tristate "AR0132 for Semidrive"
	depends on VIDEO_SEMIDRIVE_V2

config VIDEO_SEMIDRIVE_NEXTCHIP_N4
	tristate "nextchip n4 for Semidrive"
	depends on VIDEO_SEMIDRIVE_V2
	default n


config VIDEO_SEMIDRIVE_ARK7116
	tristate "ARK7116 for Semidrive"
	depends on VIDEO_SEMIDRIVE_V2

config VIDEO_SEMIDRIVE_TP2850
	tristate "tech point tp2850 for Semidrive"
	depends on VIDEO_SEMIDRIVE_V2
```

## drivers/media/platform/sdrv-cam-v2/external/serdes/Kconfig
```kconfig
config MIPI_MAX9286_FENGJING_MC163_720P_MAX96705
	tristate "mipi_max9286_fengjing_MC163_720P_MAX96705 for Semidrive."
	depends on VIDEO_SEMIDRIVE_V2

config MIPI_MAX96722_SENGYUN_IMX390C_5200_MAX9295
	tristate "mipi_max96722_sengyun_IMX390C_5200_MAX9295 for Semidrive."
	depends on VIDEO_SEMIDRIVE_V2
	
config DVP_MAX96706_FENGJING_MC163_MAX96705
	tristate "dvp_max96706_fengjing_MC163_MAX96705 for Semidrive."
	depends on VIDEO_SEMIDRIVE_V2

config MIPI_MAX96722_FENGJING_MC163_MAX96705
	tristate "mipi_max96722_fengjing_MC163_MAX96705 for Semidrive."
	depends on VIDEO_SEMIDRIVE_V2
```

## drivers/media/platform/sdrv-cam/Kconfig
```kconfig
config VIDEO_SEMIDRIVE_PARALLEL
	tristate "Semidrive Camera parallel interface"
	depends on VIDEO_SEMIDRIVE

config VIDEO_SEMIDRIVE_MIPICSI2
	tristate "Semidrive Camera MIPI-CSI2 interface"
	depends on VIDEO_SEMIDRIVE

config VIDEO_SEMIDRIVE_SRV
	tristate "AR0132 for Semidrive"
	depends on VIDEO_SEMIDRIVE
	depends on ARCH_SEMIDRIVE
	depends on RPMSG_SEMIDRIVE

config VIDEO_SEMIDRIVE_OV5640
	tristate "Ov5640 for Semidrive"
	depends on VIDEO_SEMIDRIVE

config VIDEO_SEMIDRIVE_MAX9286_MAX96705
	tristate "MAX9286 for Semidrive"
	depends on VIDEO_SEMIDRIVE

config VIDEO_SEMIDRIVE_MAX96706_MAX96705
	tristate "MAX96706 for Semidrive"
	depends on VIDEO_SEMIDRIVE

config VIDEO_SEMIDRIVE_MAX96722_MAX96705
	tristate "MAX96722/12 for Semidrive"
	depends on VIDEO_SEMIDRIVE

config VIDEO_SEMIDRIVE_AR0132_AP0101
	tristate "AR0132 for Semidrive"
	depends on VIDEO_SEMIDRIVE

config VIDEO_SEMIDRIVE_NEXTCHIP_N4
	tristate "nextchip n4 for Semidrive"
	depends on VIDEO_SEMIDRIVE
	default n

config VIDEO_SEMIDRIVE_DESERS_ADAPTIVE
	tristate "self-adaptive semidrive deser driver"
	depends on VIDEO_SEMIDRIVE

config POWER_POC_DRIVER
	tristate "deser poc driver"
	depends on VIDEO_SEMIDRIVE

config VIDEO_SEMIDRIVE_NEXTCHIP_TP2850
	tristate "tp tp2850 for Semidrive"
	depends on VIDEO_SEMIDRIVE
```

## drivers/media/platform/semidrive/Kconfig
```kconfig
#
# Multiplexer devices
#

menu "Semidrive vpu drivers"

config SEMIDRIVE_VPU_CODA988
	tristate "semidrive vpu coda988"
	---help---
	    This driver provides downloading VPU firmware and
	    communicating with VPU. This driver for hw video
	    codec embedded in semidirver-x9 SOCs. It is able
	    to handle video decoding/encoding in a range of formats.


config SEMIDRIVE_VPU_WAVE412
	tristate "semidrive vpu wave412"
	---help---
	    This driver provides downloading VPU firmware and
	    communicating with VPU. This driver for hw video
	    codec embedded in semidrive-x9 SOCs. It is able
	    to handle video decoding/encoding in a range of formats.

config SEMIDRIVE_JPU_CODAJ12
	tristate "semidrive jpu codaj12"
	---help---
	    This driver provides communicating with JPU. This driver
	    for hw codec embedded in semidrive-v9 SOCs. It is able
	    to handle jpeg decoding/encoding format.

endmenu
```

## drivers/memdisk/Kconfig
```kconfig
config MEMDISK
	tristate "Memory based disk support"
	help
	  This option provides the function memory based disk.
	  For android bootup usage, alloc system,userdata,vendor in memory.
```
