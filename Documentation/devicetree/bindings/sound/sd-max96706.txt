## Documentation/devicetree/bindings/sound/sd-max96706.txt
```
* Semidrive kunlun max96706 DTS file

Required properties :
- compatible : should be "sdrv,semidrive_serdes"

Examples :
	max96706:max96706@78 {
		model = "sdrv,semidrive_serdes";
	};
```

## Documentation/devicetree/bindings/sound/sd-tlv320aic23.txt
```
* Semidrive kunlun tlv320aic23 DTS file

Required properties :
- compatible : should be "semidrive,x9-ref-tlv320aic23"
- status : enable or disable device node

Examples :
/ {
    sound_tlv320aic23: sound@tlv320aic23 {
	compatible = "semidrive,x9-ref-tlv320aic23";
	status = "okay";
    };

    &i2c9 {
	tlv320aic23_ms: codec@1a {
	    compatible = "ti,tlv320aic23";
	    reg = <0x1a>;
	};
    }
}
```

## Documentation/devicetree/bindings/sound/semidrive,d9-ref-es7144-sound.txt
```
Semidrive ES7144 sound card driver for d9 ref

Required properties:
- compatible : "semidrive,d9-ref-es7144"

Example:

sound_es7144: sound@es7144 {
	compatible = "semidrive,d9-ref-es7144";
};
```

## Documentation/devicetree/bindings/sound/semidrive,d9-ref-es7423e-sound.txt
```
Semidrive ES7243E sound card driver for d9 ref

Required properties:
- compatible : "semidrive,d9-ref-es7243e"

Example:

sound_es7243e: sound@es7243e {
	compatible = "semidrive,d9-ref-es7243e";
};
```

## Documentation/devicetree/bindings/sound/sound_remote.txt
```
* Semidrive kunlun virtual i2s DTS file

Required properties :
 - compatible : should be "semidrive,x9-ref-mach-remote"

Examples :
	/ {
		compatible = "semidrive,x9-ref-mach-remote";
	};
```

## Documentation/devicetree/bindings/spi/spi-is62w.txt
```
iram is62w spi sensors drivers.

Required properties:
- compatible : "semidrive,is62w-spi-0"

Example:

spi6 {
	dmas = <&dmac5 X9_DMA_SLV_ID_SPI6_TX>, <&dmac5 X9_DMA_SLV_ID_SPI6_RX>;
	dma-names = "tx", "rx";
	spi_is62w@0 {
		compatible = "semidrive,is62w-spi-0";
		reg = <0>;
		spi-max-frequency = <30000000>;
		page_size = <32>;
		page_num = <0x4000>;
		die_num = <2>;
		poll_mode = <0>;
		type = <0>;
		enable_dma = <0>;
	};
};
```

## Documentation/devicetree/bindings/storage/memdisk.txt
```
* Semidrive kunlun memdisk DTS file

Required properties :
 - compatible : should be "semidrive,memdisk"

Examples :
	memdisk: memdisk@0 {
		compatible = "semidrive,memdisk";
	};
```

## Documentation/devicetree/bindings/watchdog/sdrv_wdt.txt
```
Semidrive Watchdog

Required properties:
- compatible: must be "semidrive,watchdog"
- reg: physical base address of the controller and length of the register range

Example:

	watchdog6: watchdog@0x30a30000 {
		compatible = "semidrive,watchdog";
		reg = <0x0 0x30a30000 0x0 0x1000>;
		#interrupt-cells = <1>;
		interrupts = <0 190 4>;
		interrupt-parent = <&gic5>;
		wdt,clock-source = "main-clk";
		wdt,clock-divider = <0>;
		timeout-sec = <2>;
		wdt,min-hw-hearbeat = <800>;
		wdt,max-hw-hearbeat = <2000>;
		wdt,dying-delay;
		wdt,sig-rstgen = "false";
		wdt,auto-run = "true";
		regctl = <&regctl SDRV_REG_BOOTREASON>;
		status = "disabled";
	};
```

## arch/arm64/configs/x9_ref_cluster_defconfig
```kconfig
CONFIG_SYSVIPC=y
CONFIG_NO_HZ_IDLE=y
CONFIG_HIGH_RES_TIMERS=y
CONFIG_IRQ_TIME_ACCOUNTING=y
CONFIG_BSD_PROCESS_ACCT=y
CONFIG_BSD_PROCESS_ACCT_V3=y
CONFIG_IKCONFIG=y
CONFIG_IKCONFIG_PROC=y
CONFIG_NUMA_BALANCING=y
CONFIG_MEMCG=y
CONFIG_MEMCG_SWAP=y
CONFIG_BLK_CGROUP=y
CONFIG_CGROUP_PIDS=y
CONFIG_CGROUP_HUGETLB=y
CONFIG_CPUSETS=y
CONFIG_CGROUP_DEVICE=y
CONFIG_CGROUP_CPUACCT=y
CONFIG_CGROUP_PERF=y
CONFIG_USER_NS=y
CONFIG_SCHED_AUTOGROUP=y
CONFIG_SCHED_TUNE=y
CONFIG_DEFAULT_USE_ENERGY_AWARE=y
CONFIG_BLK_DEV_INITRD=y
CONFIG_KALLSYMS_ALL=y
# CONFIG_COMPAT_BRK is not set
CONFIG_PROFILING=y
CONFIG_JUMP_LABEL=y
CONFIG_MODULES=y
CONFIG_MODULE_UNLOAD=y
CONFIG_BLK_DEV_INTEGRITY=y
CONFIG_PARTITION_ADVANCED=y
CONFIG_CMDLINE_PARTITION=y
# CONFIG_IOSCHED_DEADLINE is not set
CONFIG_ARCH_SEMIDRIVE_PROCESSOR9=y
CONFIG_PCI=y
CONFIG_ARM64_VA_BITS_48=y
CONFIG_NUMA=y
CONFIG_PREEMPT=y
CONFIG_KSM=y
CONFIG_TRANSPARENT_HUGEPAGE=y
CONFIG_CMA=y
CONFIG_SECCOMP=y
CONFIG_XEN=y
CONFIG_ARMV8_DEPRECATED=y
CONFIG_SWP_EMULATION=y
CONFIG_CP15_BARRIER_EMULATION=y
CONFIG_SETEND_EMULATION=y
# CONFIG_EFI is not set
# CONFIG_CORE_DUMP_DEFAULT_ELF_HEADERS is not set
CONFIG_COMPAT=y
CONFIG_CPU_IDLE=y
CONFIG_ARM_CPUIDLE=y
CONFIG_CPU_FREQ=y
CONFIG_CPU_FREQ_STAT=y
CONFIG_CPU_FREQ_TIMES=y
CONFIG_CPU_FREQ_DEFAULT_GOV_ONDEMAND=y
CONFIG_CPU_FREQ_GOV_USERSPACE=y
CONFIG_NET=y
CONFIG_PACKET=y
CONFIG_UNIX=y
CONFIG_XFRM_USER=y
CONFIG_INET=y
CONFIG_IP_MULTICAST=y
CONFIG_IP_PNP=y
CONFIG_IP_PNP_DHCP=y
CONFIG_IP_PNP_BOOTP=y
CONFIG_IP_PNP_RARP=y
CONFIG_NET_IPIP=y
CONFIG_NETLABEL=y
CONFIG_DNS_RESOLVER=y
CONFIG_VSOCKETS=y
CONFIG_NET_NSH=y
# CONFIG_WIRELESS is not set
CONFIG_RPMSG_PROTO=y
CONFIG_UEVENT_HELPER_PATH="/sbin/hotplug"
CONFIG_DEVTMPFS=y
CONFIG_DEVTMPFS_MOUNT=y
CONFIG_DMA_CMA=y
CONFIG_CMA_SIZE_MBYTES=256
CONFIG_MTD=y
CONFIG_MTD_BLOCK=y
CONFIG_BLK_DEV_LOOP=y
CONFIG_VIRTIO_BLK=y
CONFIG_SRAM=y
CONFIG_VDSP=y
CONFIG_XRP=y
CONFIG_XRP_HW_SEMIDRIVE=m
CONFIG_SCSI=y
# CONFIG_SCSI_PROC_FS is not set
CONFIG_BLK_DEV_SD=y
CONFIG_SCSI_SAS_LIBSAS=y
CONFIG_MD=y
CONFIG_BLK_DEV_MD=y
CONFIG_MD_LINEAR=y
CONFIG_BLK_DEV_DM=y
CONFIG_DM_VERITY=y
CONFIG_DM_VERITY_HASH_PREFETCH_MIN_SIZE_128=y
CONFIG_DM_VERITY_FEC=y
CONFIG_NETDEVICES=y
# CONFIG_ETHERNET is not set
# CONFIG_WLAN is not set
# CONFIG_XEN_NETDEV_FRONTEND is not set
CONFIG_RPMSG_NET=y
CONFIG_ULINK_NET=y
CONFIG_INPUT_POLLDEV=m
CONFIG_INPUT_MATRIXKMAP=y
CONFIG_INPUT_EVDEV=y
# CONFIG_INPUT_KEYBOARD is not set
# CONFIG_INPUT_MOUSE is not set
CONFIG_INPUT_MISC=y
# CONFIG_SERIO_SERPORT is not set
CONFIG_LEGACY_PTY_COUNT=16
CONFIG_SERIAL_8250=y
CONFIG_SERIAL_8250_CONSOLE=y
CONFIG_SERIAL_8250_NR_UARTS=16
CONFIG_SERIAL_8250_RUNTIME_UARTS=16
CONFIG_SERIAL_8250_EXTENDED=y
CONFIG_SERIAL_8250_SHARE_IRQ=y
CONFIG_SERIAL_8250_DW=y
CONFIG_SERIAL_OF_PLATFORM=y
CONFIG_SERIAL_AMBA_PL011=y
CONFIG_SERIAL_AMBA_PL011_CONSOLE=y
CONFIG_SERIAL_XILINX_PS_UART=y
CONFIG_SERIAL_XILINX_PS_UART_CONSOLE=y
CONFIG_SERIAL_SDRV_VIRT_UART=y
CONFIG_SERIAL_DEV_BUS=y
CONFIG_SERIAL_DEV_CTRL_TTYPORT=y
CONFIG_VIRTIO_CONSOLE=y
CONFIG_HW_RANDOM=y
# CONFIG_HW_RANDOM_CAVIUM is not set
CONFIG_G2D_SEMIDRIVE=y
CONFIG_I2C_CHARDEV=y
CONFIG_I2C_DESIGNWARE_PLATFORM=y
CONFIG_I2C_CROS_EC_TUNNEL=y
CONFIG_I2C_SLAVE=y
CONFIG_PTP_1588_CLOCK=y
CONFIG_PINCTRL_SDX9=y
CONFIG_GPIOLIB=y
CONFIG_GPIO_SYSFS=y
CONFIG_GPIO_SEMIDRIVE=y
CONFIG_GPIO_PCA953X=y
CONFIG_GPIO_PCA953X_IRQ=y
CONFIG_POWER_RESET_BRCMSTB=y
CONFIG_POWER_RESET_XGENE=y
CONFIG_POWER_RESET_SYSCON=y
CONFIG_SYSCON_REBOOT_MODE=y
# CONFIG_HWMON is not set
CONFIG_WATCHDOG=y
CONFIG_WATCHDOG_SYSFS=y
CONFIG_SDRV_WATCHDOG=y
CONFIG_MFD_CROS_EC=y
CONFIG_MFD_CROS_EC_I2C=y
CONFIG_MFD_SEC_CORE=y
CONFIG_RC_DEVICES=y
CONFIG_MEDIA_SUPPORT=y
CONFIG_MEDIA_CAMERA_SUPPORT=y
CONFIG_MEDIA_ANALOG_TV_SUPPORT=y
CONFIG_MEDIA_DIGITAL_TV_SUPPORT=y
CONFIG_MEDIA_CONTROLLER=y
CONFIG_VIDEO_V4L2_SUBDEV_API=y
CONFIG_SEMIDRIVE_VPU_CODA988=y
CONFIG_SEMIDRIVE_VPU_WAVE412=y
CONFIG_V4L_PLATFORM_DRIVERS=y
CONFIG_VIDEO_SEMIDRIVE_PARALLEL=y
CONFIG_VIDEO_SEMIDRIVE_MIPICSI2=y
CONFIG_VIDEO_SEMIDRIVE_SRV=y
CONFIG_POWER_POC_DRIVER=y
CONFIG_VIDEO_SEMIDRIVE_V2=y
CONFIG_MIPI_MAX9286_FENGJING_MC163_720P_MAX96705=y
CONFIG_MIPI_MAX96722_SENGYUN_IMX390C_5200_MAX9295=y
CONFIG_DVP_MAX96706_FENGJING_MC163_MAX96705=y
CONFIG_V4L_MEM2MEM_DRIVERS=y
CONFIG_ROGUE_KM=m
CONFIG_PVR_SYSTEM="kl_gm9446"
CONFIG_PVRSRV_VZ_NUM_OSID=1
CONFIG_VMM_TYPE="stub"
CONFIG_BUFFER_SYNC=y
CONFIG_DRM=y
CONFIG_DRM_PANEL_LVDS=y
CONFIG_DRM_PANEL_SIMPLE=m
CONFIG_DRM_PANEL_KUNLUN_SIMPLE=y
CONFIG_DRM_I2C_ADV7511=y
CONFIG_DRM_HISI_KIRIN=y
CONFIG_DRM_TINYDRM=y
CONFIG_DRM_SEMIDRIVE=y
CONFIG_DRM_SEMIDRIVE_VIDEO_DISPLAY=y
CONFIG_DRM_DMAFD_V2=y
CONFIG_DRM_LEGACY=y
CONFIG_FB_FOREIGN_ENDIAN=y
CONFIG_FB_TILEBLITTING=y
CONFIG_FB_ARMCLCD=y
CONFIG_FB_OPENCORES=y
CONFIG_FB_IBM_GXT4500=y
CONFIG_FB_VIRTUAL=y
CONFIG_FB_SIMPLE=y
CONFIG_BACKLIGHT_SDRV=y
CONFIG_BACKLIGHT_SDRV_NATIVE=y
CONFIG_LOGO=y
# CONFIG_LOGO_LINUX_MONO is not set
# CONFIG_LOGO_LINUX_VGA16 is not set
CONFIG_SOUND=y
CONFIG_SND=y
CONFIG_SND_HRTIMER=y
CONFIG_SND_DYNAMIC_MINORS=y
CONFIG_SND_VERBOSE_PRINTK=y
CONFIG_SND_DEBUG=y
CONFIG_SND_DEBUG_VERBOSE=y
CONFIG_SND_PCM_XRUN_DEBUG=y
CONFIG_SND_SOC=y
CONFIG_SND_X9_REF_MACH_REMOTE=y
CONFIG_SND_X9_MS_MACH=y
CONFIG_SND_SIMPLE_CARD=y
# CONFIG_USB_SUPPORT is not set
CONFIG_MMC=y
CONFIG_MMC_VIRTIO_SDHCI=y
CONFIG_RTC_CLASS=y
CONFIG_RTC_DRV_SDRV=y
CONFIG_DMADEVICES=y
CONFIG_DW_AXI_DMAC=y
CONFIG_MV_XOR_V2=y
CONFIG_ASYNC_TX_DMA=y
CONFIG_SW_SYNC=y
CONFIG_VFIO=y
CONFIG_VIRTIO_BALLOON=y
CONFIG_VIRTIO_MMIO=y
CONFIG_COMMON_CLK_VERSATILE=y
CONFIG_CLK_SP810=y
CONFIG_CLK_QORIQ=y
CONFIG_HWSPINLOCK=y
CONFIG_ARM_TIMER_SP804=y
CONFIG_MAILBOX=y
CONFIG_SEMIDRIVE_MBOX=y
CONFIG_ARM_SMMU=y
CONFIG_ARM_SMMU_V3=y
CONFIG_RPMSG_CHAR=y
CONFIG_RPMSG_SEMIDRIVE=y
CONFIG_SEMIDRIVE_IPCC=y
CONFIG_SEMIDRIVE_SCR=y
CONFIG_SEMIDRIVE_VCE=y
CONFIG_SEMIDRIVE_ULINK=y
CONFIG_SEMIDRIVE_REGCTL=y
CONFIG_SEMIDRIVE_TIME_SYNC=y
CONFIG_SEMIDRIVE_LOGBUF=y
CONFIG_PWM=y
CONFIG_PWM_CROS_EC=m
CONFIG_PWM_SD=y
CONFIG_RESET_CONTROLLER=y
CONFIG_PHY_XGENE=y
CONFIG_PHY_SEMIDRIVE_USB=y
CONFIG_MEMDISK=y
CONFIG_CRYPTO_DEV_SEMIDRIVE=y
CONFIG_EXT2_FS=y
CONFIG_EXT4_FS=y
CONFIG_EXT4_FS_POSIX_ACL=y
CONFIG_EXT4_FS_SECURITY=y
CONFIG_BTRFS_FS=m
CONFIG_BTRFS_FS_POSIX_ACL=y
CONFIG_FANOTIFY=y
CONFIG_FANOTIFY_ACCESS_PERMISSIONS=y
CONFIG_QUOTA=y
# CONFIG_PRINT_QUOTA_WARNING is not set
CONFIG_AUTOFS4_FS=y
CONFIG_FUSE_FS=m
CONFIG_CUSE=m
CONFIG_OVERLAY_FS=m
CONFIG_VFAT_FS=y
CONFIG_TMPFS=y
CONFIG_HUGETLBFS=y
CONFIG_CONFIGFS_FS=y
CONFIG_SDCARD_FS=y
CONFIG_SQUASHFS=y
CONFIG_PSTORE=y
CONFIG_PSTORE_CONSOLE=y
CONFIG_PSTORE_PMSG=y
CONFIG_PSTORE_RAM=y
CONFIG_NFS_FS=y
CONFIG_ROOT_NFS=y
CONFIG_NLS_CODEPAGE_437=y
CONFIG_NLS_ISO8859_1=y
CONFIG_PRINTK_TIME=y
CONFIG_DEBUG_INFO=y
CONFIG_PAGE_OWNER=y
CONFIG_MAGIC_SYSRQ=y
CONFIG_DEBUG_KERNEL=y
# CONFIG_FTRACE is not set
CONFIG_KEYS=y
CONFIG_SECURITY=y
CONFIG_SECURITY_NETWORK=y
CONFIG_CRYPTO_RSA=y
CONFIG_CRYPTO_ECDH=m
CONFIG_CRYPTO_CCM=y
CONFIG_CRYPTO_GCM=y
CONFIG_CRYPTO_ECHAINIV=y
CONFIG_CRYPTO_CBC=y
CONFIG_CRYPTO_XTS=y
CONFIG_CRYPTO_CMAC=y
CONFIG_CRYPTO_MD5=m
CONFIG_CRYPTO_SHA512=m
CONFIG_CRYPTO_ARC4=y
CONFIG_CRYPTO_DES=m
CONFIG_CRYPTO_ANSI_CPRNG=y
CONFIG_ARM64_CRYPTO=y
CONFIG_CRYPTO_SHA512_ARM64=m
CONFIG_CRYPTO_SHA1_ARM64_CE=y
CONFIG_CRYPTO_SHA2_ARM64_CE=y
CONFIG_CRYPTO_GHASH_ARM64_CE=y
CONFIG_CRYPTO_CRCT10DIF_ARM64_CE=m
CONFIG_CRYPTO_CRC32_ARM64_CE=m
CONFIG_CRYPTO_AES_ARM64_CE_CCM=y
CONFIG_CRYPTO_AES_ARM64_CE_BLK=y
CONFIG_CRYPTO_CHACHA20_NEON=m
CONFIG_CRYPTO_AES_ARM64_BS=m
CONFIG_LIBCRC32C=y
```
