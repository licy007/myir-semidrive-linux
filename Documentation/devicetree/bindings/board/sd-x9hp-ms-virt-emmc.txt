## Documentation/devicetree/bindings/board/sd-x9hp-ms-virt-emmc.txt
```
* Semidrive kunlun platform DTS file

Required properties :
 - compatible : should be "semidrive,kunlun"

Optional:
 - model : The name of the board

Examples :

		/ {
			model = "Semidrive kunlun x9 MS Board";
			compatible = "semidrive,kunlun";
		};
```

## Documentation/devicetree/bindings/cpufreq/sdrv-cpufreq.txt
```
Semidrive cpufreq driver
-------------------

Semidrive SoC cpufreq driver for CPU frequency scaling.

Required properties:
- compatible: should be "semidrive,sdrv-cpufreq".
- trans-delay-us: the delay time(us) for next scaling.
- start-time: the time which start after kernel boot (seconds).

Optional properties:
- frequency-list: define the freq table.
- min-freq: define the min freq.
- max-freq: define the max freq.
if no frequency-list, will use the min-freq and max-freq to calcurate the freqs.

Examples:
--------
    sdrvcpufreq: cpufreq {
                compatible = "semidrive,sdrv-cpufreq";
                min-freq = <100000000>; /* hz */
                max-freq = <0xffffffff>; /* driver will using the minimum value between this value and pll capability */
                frequency-list = <100000000 300000000 1100000000 1600000000>;
                trans-delay-us = <200000>;
                start-time = <10>; /*second*/
                status = "okay";
    };
```

## Documentation/devicetree/bindings/crashdump/sdrv_crashdump.txt
```
Semidrive Crashdump

Required properties:
- compatible: must be "crashdump"
- reg: physical base address of the controller and length of the register range

Example:

	crashdump {
		/* reserve preloader mem for crashdump */
		compatible = "crashdump";
		reg = <HIGH32(AP2_PRELOADER_MEMBASE) LOW32(AP2_PRELOADER_MEMBASE) 0 AP2_PRELOADER_MEMSIZE>;
	};
```

## Documentation/devicetree/bindings/crtc/crtc.txt
```
Generic device tree bindings for crtc
===========================================

This document describes generic bindings which can be used to describe crtc
busses in a device tree.

Required properties
-------------------
- compatible
    should contain "semidrive,kunlun-crtc"

- status:
    "okay" or "disabled"

- sdrv,ip
    select different crtc operation

Example:

crtc0: crtc0 {
			compatible = "semidrive,kunlun-crtc";
			dpc-master = <&dc1>;
			/* 1 single, 2: duplicate, 3: combine */
			display-mode = <1>;

			crtc0_out: port {
				crtc0_out_interface: endpoint@0 {
					remote-endpoint = <&parallel_in_crtc0>;
				};
			};
};
```

## Documentation/devicetree/bindings/dc/dc.txt
```
Generic device tree bindings for dc
===========================================

This document describes generic bindings which can be used to describe dc
busses in a device tree.

Required properties
-------------------
- compatible
    should contain "sdrv,dc"

- status:
    "okay" or "disabled"

- sdrv,ip
    select different dc operation

Example:

dc1: dc1@30db0000 {
			compatible = "sdrv,dc";
			reg = <DC1_BASE DPU_RANGE>;
			interrupts = <0 DC1_IRQ 4>;
			status = "disabled";
			sdrv,ip = "dc-r0p1";
			clocks = <&PLL_LVDS1 PLL_DIVA>;
			clock-names = "pll_clk";
		};
```

## Documentation/devicetree/bindings/dc/dp.txt
```
Generic device tree bindings for dp
===========================================

This document describes generic bindings which can be used to describe dp
busses in a device tree.

Required properties
-------------------
- compatible
    should contain "sdrv,dp"

- status:
    "okay" or "disabled"

- sdrv,ip
    select different dp operation

Example:

dp1: dp1@30d80000 {
	compatible = "sdrv,dp";
	reg = <DP1_BASE DPU_RANGE>;
	interrupts = <0 DP1_IRQ 4>;
	status = "disabled";
	mlc-select = <0>;
	sdrv,ip = "dp-r0p1";
};
```

## Documentation/devicetree/bindings/display/sd-serdes-gt9xx-14-j34.txt
```
* Semidrive kunlun serdes_gt9xx_14_j34 touch DTS file

Required properties :
- compatible : should be "sdrv,ds947_ds948_gt9xx"

Examples :
	serdes_gt9xx_14_j34:touch@5d {
		model = "sdrv,ds947_ds948_gt9xx";
	};
```

## Documentation/devicetree/bindings/display/sd-serdes-gt9xx-16-j35.txt
```
* Semidrive kunlun ds941_ds948_gt9xx touch DTS file

Required properties :
- compatible : should be "sdrv,ds941_ds948_gt9xx"

Examples :
	serdes_gt9xx_16_j35:touch@5d {
		model = "sdrv,ds941_ds948_gt9xx";
	};
```

## Documentation/devicetree/bindings/display/sd-serdes-gt9xx-16-j35a.txt
```
* Semidrive kunlun serdes_gt9xx_16_j35a touch DTS file

Required properties :
- compatible : should be "sdrv,ds941_ds948_gt9xx"

Examples :
	serdes_gt9xx_16_j35a:touch@14 {
		model = "sdrv,ds941_ds948_gt9xx";
	};
```

## Documentation/devicetree/bindings/display/sdrv_display.txt
```
Generic device tree bindings for semidrive's display
===========================================

This document describes generic bindings which can be used to describe semidrive's display
busses in a device tree.

Required properties
-------------------
- compatible
    should contain "semdrive,display-subsystem"

- status:
    "okay" or "disabled"

Example:
display: display@0 {
	compatible = "semdrive,display-subsystem";
	sdriv,crtc = <&crtc0>;
	status = "disabled";
};
```

## Documentation/devicetree/bindings/gpu/semidrive,mipi-panel.txt
```
Semidrive display mipi panel driver.

Required properties:
- compatible : "semidrive,mipi-panel"

Example:

dsi1 {
	panel {
		compatible = "semidrive,mipi-panel";
		#address-cells = <1>;
		#size-cells = <0>;
		reg = <0>;
		status = "okay";
		semidrive,lcd-attached = "lcd_hsd123_serdes_mipi_1920x720";
	};
};
```

## Documentation/devicetree/bindings/hwmon/lm75.txt
```
* LM75 thermometer.

Required properties:
- compatible: "sgmicro,sgm452"

Example:

i2c4 {
	dtt@4f {
		compatible = "sgmicro,sgm452";
		reg = <0x4f>;
	};
};
```

## Documentation/devicetree/bindings/i2c/i2c-sd-virtual.txt
```
* Semidrive Virtual I2C

Required properties :

 - compatible : should be "sd,virtual-i2c"
 - phy-num : /bits/ 8 <xxx>; xxx should be the physical adapter num 0 or 1 ...or 15

Examples :

	i2c5:i2c@30ad0000 {
		compatible = "sd,virtual-i2c";
		phy-num = /bits/ 8 <5>;
	};

	i2c15:i2c@30b70000 {
		compatible = "sd,virtual-i2c";
		phy-num = /bits/ 8 <15>;
	}
```

## Documentation/devicetree/bindings/input/touchscreen/semidrive_ts.txt
```
Semidrive touchscreen, based on Semidrive Mailbox Controller,
is designed for inter-core communication.

Required properties:
- compatible : "sd,safetouch"

Example:

semidrive_ts0:semidrive_ts@0 {
	compatible = "sd,safetouch";
};
```

## Documentation/devicetree/bindings/leds/sd-panel0-backlight.txt
```
* Semidrive kunlun panel backlight DTS file

Required properties :
- compatible : should be "sd,rpmsg-bl"
- status : enable or disable device node

Examples :
	semidrive_bl0: panel0-backlight {
		model = "sd,rpmsg-bl";
		status = "okay";
	};
```

## Documentation/devicetree/bindings/lt9611/lt9611.txt
```
Generic device tree bindings for lt9611
===========================================

This document describes generic bindings which can be used to describe lt9611
busses in a device tree.

Required properties
-------------------
- compatible
    should contain "semidrive,lt9611"

- status:
    "okay" or "disabled"

Example:

    i2c@00000000 {
        /* ... */

        lt9611_bridge: bridge@39 {
            status = "okay";
            compatible = "semidrive,lt9611";
            reg = <0x39>;   /* i2c device address */
            /* GPIO_D9 */
            lt9611-rst-gpios = <&port4c 9 GPIO_ACTIVE_HIGH>;
        };

        /* ... */
    };
```

## Documentation/devicetree/bindings/media/semidrive,extra-sensor.txt
```
Semidrive camera use external sensors drivers.

Required properties:
- compatible : one of
		"tp,tp2850"
		"nextchip,n4"

Example:

i2c7 {
	dvp_tp2850:dvp_tp2850@44 {
		compatible = "tp,tp2850";
		reg = <0x44>;
		sync = <0>;
		rst-gpios = <&port4c 19 GPIO_ACTIVE_HIGH>;//index(79) gpio D15
		port {
			cam2_to_parallel:endpoint {
				remote-endpoint = <&csiparallel0_in>;
			};
		};
	};
};

i2c9 {
	n4:n4@31 {
		compatible = "nextchip,n4";
		reg = <0x31>;
		sync = <0>;
		pwdn-gpios = <&port4d 27 GPIO_ACTIVE_HIGH>;//index(123) gpio h1
		rst-gpios = <&port4c 15 GPIO_ACTIVE_HIGH>;//index(79) gpio D15
		ports {
			port@0 {
				#address-cells = <1>;
				#size-cells = <0>;

				cam0_to_mipi_0: endpoint {
					remote-endpoint = <&csimipi0_0_in>;
				};
			};
			port@1 {
				#address-cells = <1>;
				#size-cells = <0>;

				cam0_to_mipi_1: endpoint {
					remote-endpoint = <&csimipi0_1_in>;
				};
			};
			port@2 {
				#address-cells = <1>;
				#size-cells = <0>;

				cam0_to_mipi_2: endpoint {
					remote-endpoint = <&csimipi0_2_in>;
				};
			};
			port@3 {
				#address-cells = <1>;
				#size-cells = <0>;

				cam0_to_mipi_3: endpoint {
					remote-endpoint = <&csimipi0_3_in>;
				};
			};
		};
	};
};
```

## Documentation/devicetree/bindings/media/semidrive-camera.txt
```
Semidrive KUNLUN X9 camera host interface

* Properties

- compatible:
	Usage: required
	Value type: <stringlist>
	Definition: Should contain:
		- "semdrive,kunlun-csi"
		- "semidrive,sdrv-csi"
		- "semidrive,sdrv-csi-mipi"
- reg:
	Usage: required
	Value type: <prop-encoded-array>
	Definition: Register ranges as listed in the reg-names property.

- interrupts:
	Usage: required
	Value type: <prop-encoded-array>
	Definition: Interrupts as listed in the interrupt-names property.

- mbus-type:
	Usage: required
	Value type: <stringlist>
	Definition: Should contain the following entries:
                - "mipi-csi2"
                - "parallel"


* Nodes

- ports:
	Usage: required
	Definition: As described in video-interfaces.txt in same directory.
	Properties:
		- reg:
			Usage: required
			Value type: <u32>
			Definition: Selects CSI stream index.


* Example:

	csi0:csi@30cc0000 {
			compatible = "semdrive,kunlun-csi";
			reg = <0x0 0x30CC0000 0x0 0x10000>;
			interrupts = <0 141 4>;
			host_id = <0>;
			mbus-type = "mipi-csi2";
			status = "okay";

			ports {
				#address-cells = <1>;
				#size-cells = <0>;

				csi0_stream0: port@0 {
					#address-cells = <1>;
					#size-cells = <0>;
					reg = <0>;
					csi0_stream0_in: endpoint@0 {
						reg = <0>;
					};
				};

				csi0_stream1: port@1 {
					#address-cells = <1>;
					#size-cells = <0>;
					reg = <1>;
					csi0_stream1_in: endpoint@0 {
						reg = <1>;
					};
				};

				csi0_stream2: port@2 {
					#address-cells = <1>;
					#size-cells = <0>;
					reg = <2>;
					csi0_stream2_in: endpoint@0 {
						reg = <2>;
					};
				};

				csi0_stream3: port@3 {
					#address-cells = <1>;
					#size-cells = <0>;
					reg = <3>;
					csi0_stream3_in: endpoint@0 {
						reg = <3>;
					};
				};
			};
	};
```

## Documentation/devicetree/bindings/media/semidrive-serdes.txt
```
Semidrive adaptive-serdes

Required properties:
- compatible: should be "sdrv,dvp_deser"
- reg: slave address for i2c for serdes

Example:

    dvp_deser:dvp_deser@7E {
        compatible = "sdrv,dvp_deser";
        clock-frequency = <24000000>;
        reg = <0x7E>;
        type = <SERDES_PARALLEL>;
        pwdn-gpios = <&port4c 19 0>;
        poc-gpios = <&cam_gpios 8 0>;
        gpi-gpios = <&cam_gpios 11 0>;
        port {
            #address-cells = <1>;
            #size-cells = <0>;

            dvpdeser_to_parallel: endpoint {
                remote-endpoint = <&csiparallel0_in>;
            };
        };
    };
```

## Documentation/devicetree/bindings/misc/cdns,xrp-hw-semidrive,v1.txt
```
 * Bindings for the Cadence Xtensa Remote Processing Semidrive HW-specific driver.

Required properties:
- compatible: shall be "cdns,xrp-hw-semidrive,v1".
- reg: register locations of the DSP shared memory (first entry, same as in
       cdns,xrp,v1) and DSP MMIO block (second entry).

Optional properties:
- device-irq: 1 32-bit cells:
    DSP IRQ number (normal core IRQ number, not external IRQ number)
  controlled by this register/bit.

- device-irq-mode: 0 for none (polling), 1 for IRQ mode

- host-irq: 1 32-bit cells:
    host IRQ number

- host-irq-mode: 0 for none (polling), 1 for IRQ mode

- firmware-name: string identifying firmware name. If missing the driver
  doesn't load the firmware.

- ranges: standard ranges property. Provides mapping of DSP physical addresses
  to host physical addresses. Arbitrary number of groups with the following
  structure:
  - cells with DSP physical address of the region;
  - cells with the corresponding host physical address of the
    region;
  - cells with the size of the region.

Example:

	xrp@0 {
		#address-cells = <1>;
		#size-cells = <1>;
		compatible = "cdns,xrp-hw-simple,v1";
		reg = <0xf0000000 0x01000000   /* DSP shared memory */
		       0xfd001000 0x00000200>; /* DSP MMIO */
		device-irq = <23>; /* IRQ# */
		device-irq-mode = <1>;
		host-irq = <232>; /* IRQ# */
		host-irq-mode = <1>;
		firmware-name = "xrp0.elf";
		ranges = <0x00000000 0x00000000 0x10000000
			  0x3ffc0000 0xc0000000 0x00020000
			  0x3ffe0000 0xc0020000 0x00020000
			  0x50000000 0x50000000 0x01000000
			  0x60000000 0x60000000 0x20000000
			  0xf0000000 0xf0000000 0x0d000000>;
		dsp@0 {
		};
	};
```

## Documentation/devicetree/bindings/mtd/sdrv,ospi-nor.txt
```
* SPI NOR flash: ST M25Pxx (and similar) serial flash chips

Required properties:
- #address-cells, #size-cells : Must be present if the device has sub-nodes
  representing partitions.
- compatible : "sdrv,spi-nor"
- reg : the base addr of ospi controler
- interrupts : the interrupts no of ospi controler
- cdns,fifo-depth : the depth of fifo
- cdns,fifo-width : the width of fifo
- cdns,trigger-address : the address of ospi controler
- clocks : the clock soure of ospi controler

Example:

	ospi1: spi@30020000 {
        	compatible = "sdrv,ospi-nor";
        	#address-cells = <1>;
        	#size-cells = <0>;
        	reg = <0 0x30020000 0 0x10000>,
                	<0 0x4000000 0 0x4000000>;
        	interrupts = <GIC_SPI 56 IRQ_TYPE_LEVEL_HIGH>;
        	cdns,fifo-depth = <256>;
        	cdns,fifo-width = <4>;
        	cdns,trigger-address = <0x3fffe00>;
        	clocks = <&OSPI1>;
        	status = "disabled";
	};
```

## Documentation/devicetree/bindings/mtd/spi-nand.txt
```
* SPI NAND flash

Required properties:
- #address-cells, #size-cells : Must be present if the device has sub-nodes
  representing partitions.
- compatible : "sdrv,spi-nor"
- reg : the base addr of ospi controler
- cdns,read-delay: the delay clock of read
- spi-max-frequency: the max clock frequency of spi
- page-size: NAND's page-size
- block-size: NAND's block-size
Example:

	spi-nand@0 {
		compatible = "spi-nand";
		cdns,read-delay = <1>;
		cdns,tshsl-ns = <50>;
		cdns,tsd2d-ns = <50>;
		cdns,tchsh-ns = <50>;
		cdns,tslch-ns = <50>;
		spi-max-frequency = <100000000>;
		reg = <0>;
		page-size = <256>;
		block-size = <12>;
		status = "disabled";
	};
```

## Documentation/devicetree/bindings/net/can/sdrv-flexcan.txt
```
Flexcan CAN controller on Semidrive's ARM system-on-a-chip (SOC).

Required properties:

- compatible : Should be "semidrive,flexcan"

- reg : Offset and length of the register set for this device
- interrupts : Interrupt tuple for this device

Example:
		flexcan1: can@30030000 {
			compatible = "semidrive,flexcan";
			reg = <0x0 0x30030000 0x0 0x10000>;
			interrupts = <GIC_SPI 118 IRQ_TYPE_LEVEL_HIGH>;
			status = "disabled";
		};
```
