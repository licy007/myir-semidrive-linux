## Documentation/devicetree/bindings/rpmsg/sd-rpmsg-vq-rp-ap.txt
```
Semidrive rpmsg-vq rp_ap
=====================

Semidrive rpmsg-vq rp_ap, based on Semidrive
Mailbox Controller, is designed for inter-core communication.

rpmsg-vq rp_ap Node:
=================

Required properties:
--------------------
- compatible :
- mboxes :

Example:
--------
	rpmsg4: rpmsg@4 {
		compatible = "sd,rpmsg-vq,rp_ap";
		mboxes = <&mbox 0x19 0x1904>;
		status = "disabled";
	};
```

## Documentation/devicetree/bindings/rpmsg/semidrive-ipcc.txt
```
Semidrive IPCC Driver
=====================

Semidrive Inter-Processor Communication Controller (IPCC), based on Semidrive
Mailbox Controller, is designed for inter-core communication.

IPCC Device Node:
=================

Required properties:
--------------------
- compatible :		Should be "sd,rpmsg-ipcc".
- mboxes :		This is a phandle object consisting of 3 parts. The
			first is a handle to mailbox node. The second is
			mailbox local address. The last is an unsigned short
			with high byte as mailbox remote address and low byte
			as mailbox remote processor ID. See semidrive-mailbox
			for details.

Optional properties:
--------------------
- rpmsg-mtu :		Set MTU for device, will be RPMSG_DEFAULT_HW_MTU if
			not set.
- tx-desc-num :		Number of TX buffer, will be RPMSG_DEFAULT_TXD_NUM if
			not set.

Example:
--------
	ipcc0: ipcc@0 {
		compatible = "sd,rpmsg-ipcc";
		mboxes = <&mbox 0x33 0x3300>;
		#rpmsg-cells = <2>;
		rpmsg-mtu = <1024>;
		status = "disabled";
	};
```

## Documentation/devicetree/bindings/rpmsg/semidrive-ulink-channel.txt
```
Semidrive ulink channel driver.

Required properties:
- compatible : "sd,ulink-channel"

Example:

ulink_channel1: ulink_channel1 {
	compatible = "sd,ulink-channel";
	mboxes = <&mbox 0xb4 0xb404>;
	rproc = <4>;
	status = "okay";
};
```

## Documentation/devicetree/bindings/rpmsg/semidrive-ulink-net.txt
```
Semidrive ulink net driver.

Required properties:
- compatible : "sd,ulink-net"

Example:

ulink_net: ulink_net {
	compatible = "sd,ulink-net";
	default_rproc = <4>;
	status = "okay";
};
```

## Documentation/devicetree/bindings/semidrive-pvr-rogue.txt
```
semidrive pvr-rogue specific node properties:
================================================================================

Optional:

- compatible
    should contain "imagination,pvr-rogue"

- clocks
	the clock of this module

- clock-names
	the clock's name

- operating-points-v2
	gpu runtime settings

- resets
	module reset settings

- status:
    "okay" or "disabled"

Examples:

	gpu1:gpu1@34c00000 {
		compatible = "imagination,pvr-rogue";
		reg = <0x0 0x34c00000 0x0 0x80000>;
		interrupts = <0 149 4>;
		clocks = <&GPU1_0>;
		clock-names = "gpucoreclk";
		operating-points-v2 = <&gpu0_opp_table>;
		resets = <&rstgen RSTGEN_MODULE_GPU1_CORE>, <&rstgen RSTGEN_MODULE_GPU1_SS>;
		reset-names = "gpucore-reset", "gpusys-reset";
		status = "disabled";
	};
```

## Documentation/devicetree/bindings/semidrive-xen.txt
```
semidrive virtulization specific node properties:
================================================================================

Optional:

- xen,passthrough : any device with this property, will not
  be exposed to DOM0 and therefore no driver will be loaded in hypervisor.

- xen,dom0-iommus : this device will be loaded in hypersior as a iommu master.
  also `xen,mids' and `sid' are MUST required properties. 

- xen,mids : master id list of this device, should be <id1, id2, ...>,
  hypervisor will set this master's stream id as `sid'

- sid : this device's stream id, refer `dt-bindings/soc/sdrv-xen.h'

- vm,passthrough : this prop is for dtb-to-xl-cfg tool, this node will be treated
  as a dtdev cfg. this property is only used in vm dts.

Examples:

gpu0_0@34c00000 {
                        compatible = "imagination,pvr-9446";
                        reg = <0x00 0x34c00000 0x00 0x80000>;
                        interrupts = <0x00 0x96 0x04>;
                        clock-frequency = <0x2faf0800>;
                        osid = <0x00>;
                        status = "okay";
                        xen,dom0-iommus; // or xen,passthrough;
                        xen,mids = <0x38>;
                        sid = <SDRV_SID_GPU0_0>;
};
```

## Documentation/devicetree/bindings/soc/semidrive/camera/sd-camera-cs.txt
```
* Semidrive kunlun camera cs DTS file

Required properties :
- compatible : should be "sd,sdrv_dummy"

Examples :
semidrive_cs:semidrive_cs{
	compatible = "sd,sdrv_dummy";
};
```

## Documentation/devicetree/bindings/soc/semidrive/display/sd-simulated-display.txt
```
* Semidrive kunlun simulated display  DTS file

Required properties :
- compatible : should be "sd,sdrv-simu-disp"

Examples :
simulated_display0: simulated_display {
	compatible = "sd,sdrv-simu-disp";
};
```

## Documentation/devicetree/bindings/soc/semidrive/ethernet/ethernet_phy.txt
```
* Semidrive kunlun ethernet phy DTS file

Required properties :
- compatible : should be "ethernet-phy-id0022.1620" or "ethernet-phy-ieee802.3-c22" or "ethernet-phy-id001c.c916" or "ethernet-phy-ieee802.3-c22" or "ethernet-phy-id001c.cb30" or "ethernet-phy-ieee802.3-c22"

Examples :
	eth_phy2 {
		compatible = "ethernet-phy-id0022.1620", "ethernet-phy-ieee802.3-c22";
	};
```

## Documentation/devicetree/bindings/soc/semidrive/imu/sd-imu.txt
```
* Semidrive kunlun simulated imu DTS file

Required properties :
- compatible : should be "st,asm330lhh"

Examples :
asm330lhh:asm330lhh@6a {
	compatible = "st,asm330lhh";
};
```

## Documentation/devicetree/bindings/soc/semidrive/property.txt
```
Semidrive Dcf Property Driver
=====================

Semidrive dcf device driver, based on Semidrive
domain communication framework, is designed for
remote manipulation of property values.

Dcf Device Node:
=================

Required properties:
--------------------
- compatible :		Should be "sd,property".
- endpoint :		endpoint for create rpmsg channel.

Example:
--------
	dcf_property:property@0 {
		compatible = "sd,property";
		endpoint = <13>;
		status = "disabled";
	};
```

## Documentation/devicetree/bindings/soc/semidrive/sdrv-clk.txt
```
Semidrive pll&ckgen driver
-------------------

1.Semidrive pll driver

Required properties:
- compatible: should be "semidrive,pll".
- reg: register.

Optional properties:
- sdrv,pll-diva: have pll diva.
- sdrv,pll-divb: have pll divb.
- sdrv,pll-divc: have pll divc.
- sdrv,pll-divd: have pll divd.

Examples:
--------
    PLL_CPU1A: PLL_CPU1A {
        compatible = "semidrive,pll";
        reg = <0 0x314A0000 0 0x10000>;
        #clock-cells = <1>;
        sdrv,pll-diva = <2>;
        sdrv,pll-divb = <4>;
        sdrv,pll-divc = <4>;
        sdrv,pll-divd = <4>;
        sdrv,clk-readonly = <1>;
    };

2.Semidrive ckgen driver

Required properties:
- compatible: should be "semidrive,clkgen-composite".
- reg: register.
- sdrv,type: clk type.
- clocks: parent list.

Examples:
--------
    CPU1A: CPU1A {
        compatible = "semidrive,clkgen-composite";
        reg =  <0 0x360c0000 0 0x1000>;
        #clock-cells = <0>;
        sdrv,type =<CLK_TYPE_CORE>;
        clocks=<&RC_24M>, <&XTAL_24M>, <&PLL1_DIVA>, <&PLL2_DIVA>;
    };
```

## Documentation/devicetree/bindings/soc/semidrive/sdrv_rtc.txt
```
* Semidrive X9 rtc DTS file
Required properties :
 - compatible : should be "semidrive,sdrv-rtc"
 - reg :        Address and size of the register set for RTC2
 - interrupts:  Optional property to specify the interrupt mapping
 - status :     enable or disable device node
Examples :
                rtc: rtc@0x31810000 {
                        compatible = "semidrive,sdrv-rtc";
                        reg = <0x0 0x31810000 0x0 0x10000>;
                        interrupts = <0 220 IRQ_TYPE_LEVEL_HIGH>;
                        status = "disabled";
                };
```

## Documentation/devicetree/bindings/soc/semidrive/sound/sd-codec.txt
```
* Semidrive kunlun codec DTS file

Required properties :
- compatible : should be "semidrive,x9-msb1-tlv320aic23"

Examples :
sndb1_tlv320aic23: sndb1@tlv320aic23 {
	compatible = "semidrive,x9-msb1-tlv320aic23";
};
```

## Documentation/devicetree/bindings/soc/semidrive/str.txt
```
Semidrive STR components
=====================

Semidrive Suspend-To-Ram (STR) feature,
include str sync and str power key modules.

1. STR Sync Node:
=================

Required properties:
--------------------
- compatible :		Should be "sd,str-sync".
- mboxes :		This is a phandle object consisting of 3 parts. The
			first is a handle to mailbox node. The second is
			mailbox local address. The last is an unsigned short
			with high byte as mailbox remote address and low byte
			as mailbox remote processor ID. See semidrive-mailbox
			for details.

Optional properties:
--------------------
- host :		indicate if this is a host to send the str request to
			remote, or client to receive the str request.

Example:
--------
	str_sync: str_sync {
		compatible = "sd,str-sync";
		mboxes = <&mbox 0x49 0x4904>;
		host = <0>;
		status = "disabled";
	};
2. STR Power Key Node:
======================
android os need handle the power key event to do something.
Required properties:
--------------------
- compatible :		Should be "sd,str-power-key".
- reg :			the address which store the str resume flag, the driver
			will check if this is STR resume.
Example:
--------
	str_power_key: str_power_key {
		compatible = "sd,str-power-key";
		reg = <0x0 (SAF_AP1_MEMBASE+0x10000000+0x100000) 0x0 0x1000>;
		status = "okay";
	};
```

## Documentation/devicetree/bindings/soc/semidrive/time_sync.txt
```
Semidrive X9 time_sync components
=====================
time-sync uses a C/S architecture to deliver time information through mailbox. That means server can
send time to client

Required properties :
 - compatible : should be "sd,time-sync"
 - mboxes ：    This is a phandle object consisting of 3 parts. The
 		first is a handle to mailbox node. The second is
                mailbox local address. The last is an unsigned short
                with high byte as mailbox remote address and low byte
                as mailbox remote processor ID. See semidrive-mailbox
                for details.
 - rproc ：     should be it own domain ID,where domain ID enum is,
 		safety:0
                sec:1
                mpc:2
                AP1:3
                AP2:4
 - sendto :     this consists 5 node,when the node is 1,it means the mailbox channel
		to remote domain is enable.otherwise,the channel is disable
 - master :     when master is 1,it will be a server,otherwise,it will be a client.

Examples :
	time_sync: time_sync {
		compatible = "sd,time-sync";
		mboxes = <&mbox 0xbd 0xbd00>,<&mbox 0xbd 0xbd01>,
				<&mbox 0xbd 0xbd02>,<&mbox 0xbd 0xbd03>,
				<&mbox 0xbd 0xbd04>;
		rproc = <3>;
		sendto = <1 0 0 0 1>;
		master = <1>;
		status = "okay";
	};
```

## Documentation/devicetree/bindings/soc/semidrive/touch/sd-touch.txt
```
* Semidrive kunlun simulated touch DTS file

Required properties :
- compatible : should be "siw,sw4101"

Examples :
siw4101_main:touch@50 {
	compatible = "siw,sw4101";
}

siw4101_aux:touch@51 {
	compatible = "siw,sw4101";
}
```

## Documentation/devicetree/bindings/soc/semidrive/unilink/sd-unilink-pcie.txt
```
* Semidrive kunlun ulink pcie DTS file

Required properties :
- compatible : should be "sd,ulink-pcie-rc" or "sd,ulink-pcie-ep"

Examples :
ulink_pcie: ulink_pcie{
	compatible = "sd,ulink-pcie-rc";
};
```

## Documentation/devicetree/bindings/soc/semidrive/unilink/sd-vi2s-unilink.txt
```
* Semidrive kunlun vi2s_unilink DTS file

Required properties :
- compatible : should be "semidrive,sdrv-i2s-unilink"

Examples :
vi2s_unilinkX: vi2s_unilink@X{
	compatible = "semidrive,sdrv-i2s-unilink";
};
```

## Documentation/devicetree/bindings/soc/semidrive/vircan.txt
```
Semidrive Vircan Driver
=====================

Semidrive Virtual Can device driver, based on Semidrive
rpmsg framework, is designed for transmit can frame between
A core and R core.

Vircan Device Node:
=================

Required properties:
--------------------
- compatible :		Should be "sd,vircan".
- endpoint :		endpoint for create rpmsg channel.

Optional properties:
--------------------
- canif-bind :		Set Can controller for device, will be searched by name if
			not set.

Example:
--------
	dcf_vircan0:vircan@0 {
		compatible = "sd,vircan";
		endpoint = <101>;
		canif-bind = <2>;
		status = "disabled";
	};
```

## Documentation/devicetree/bindings/soc/semidrive/virtual/safety_virtio.txt
```
* Semidrive kunlun virtual safety core DTS file

Required properties :
- compatible : should be "sd,virtio-service"
- status : enable or disable device node

Examples :
	safety_virtio {
		model = "sd,virtio-service";
		status = "disabled";
	};
```

## Documentation/devicetree/bindings/soc/semidrive/virtual/secure_virtio.txt
```
* Semidrive kunlun virtual secure core DTS file

Required properties :
- compatible : should be "sd,virtio-service"
- status : enable or disable device node

Examples :
	secure_virtio {
		model = "sd,virtio-service";
		status = "disabled";
	};
```

## Documentation/devicetree/bindings/soc/semidrive/virtual/virtio_vpu.txt
```
* Semidrive kunlun virtual vpu DTS file

Required properties :
- compatible : should be "sd,vfe-mmio"
- status : enable or disable device node

Examples :
	virtio_vpu1 {
		model = "sd,vfe-mmio";
		status = "okay";
	};
```

## Documentation/devicetree/bindings/sound/es7243e.txt
```
ES7243E i2s DA converter

Required properties:
- compatible : "MicArray_0"

Example:

i2c6 {
	es7243e: codec@10 {
		compatible = "MicArray_0";
		reg = <0x10>;
	};
};
```

## Documentation/devicetree/bindings/sound/sd-ak7738.txt
```
* Semidrive kunlun ak7738  DTS file

Required properties :
- compatible : should be "semidrive,x9-ms-mach"
- status : enable or disable device node

Examples :
/ {
    sound_ak7738: sound@ak7738 {
        model = "semidrive,x9-ms-mach";
	status = "okay";
    };

    &i2c5 {
        ak7738:codec@1c {
	    compatible = "akm,ak7738";
        }
    }
}
```
